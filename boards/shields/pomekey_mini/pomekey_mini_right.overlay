#include "pomekey_mini.dtsi"

&default_transform {
    col-offset = <5>; 
};

&kscan0 {
    gpios
        = <&gpio0 10 GPIO_ACTIVE_HIGH>  // GPIO5 (P0.10)
        , <&xiao_d 7 GPIO_ACTIVE_HIGH>   // GPIO4 (D7)
        , <&xiao_d 8 GPIO_ACTIVE_HIGH>   // GPIO3 (D8)
        , <&xiao_d 6 GPIO_ACTIVE_HIGH>   // GPIO2 (D6)
        , <&xiao_d 3 GPIO_ACTIVE_HIGH>   // GPIO1 (D3)
        , <&xiao_d 2 GPIO_ACTIVE_HIGH>   // GPIO0 (D2)
        ;

    interrupt-gpios = <&xiao_d 1 (GPIO_ACTIVE_HIGH | GPIO_PULL_DOWN)>; // gpio_interrupt (D1)
};

&encoder {
    status = "okay";
};
