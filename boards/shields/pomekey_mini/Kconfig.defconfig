## boards/shields/pomekey_mini/Kconfig.defconfig
```kconfig
if SHIELD_POMEKEY_MINI_LEFT || SHIELD_POMEKEY_MINI_RIGHT

config ZMK_KEYBOARD_NAME
    default "pomekey_mini"

config NFCT_PINS_AS_GPIOS
    default y

config ZMK_SPLIT
    default y

config ZMK_POINTING
    default y

# Note: These values are already defined in ZMK/Zephyr Kconfig.
# We just want to set their default values for this shield.
# We use 'select' or just 'default' if the symbols are already visible.

endif
```

## boards/shields/pomekey_mini/Kconfig.shield
```kconfig
config SHIELD_POMEKEY_MINI_LEFT
    def_bool $(shields_list_contains,pomekey_mini_left)
    select KSCAN
    select ZMK_KSCAN
    select ZMK_KSCAN_CHARLIEPLEX
    select ZMK_PHYSICAL_LAYOUTS
    select SPI
    select ZMK_POINTING

config SHIELD_POMEKEY_MINI_RIGHT
    def_bool $(shields_list_contains,pomekey_mini_right)
    select KSCAN
    select ZMK_KSCAN
    select ZMK_KSCAN_CHARLIEPLEX
    select ZMK_PHYSICAL_LAYOUTS
    select SPI
    select ZMK_POINTING
```
